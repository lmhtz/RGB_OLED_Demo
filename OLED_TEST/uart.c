#include "STC12C5A60S2.H"
#include <string.h>
#include "uart.h"
#include "myfun.h"

/**************************************************************************
 - 功能描述：51单片机的串口初始化
 - 隶属模块：STC51串口操作
 - 函数属性：外部，使用户使用
 - 参数说明：无
 - 返回说明：无
 **************************************************************************/

void UART_Init()     
{
 PCON|=0x80; //PCON的最高位SMOD=1时波特率加倍 
 TMOD|=0x20;  //时器1为方式2 初值自动装入 产生波特率
 TH1 = TL1 =  256-(FOSC*2/12/32/BAUD);
 SCON|=0x50;	 //串口设置为方式1,REN=1,允许接收
 TR1=1;      //启动定时器1
 //ES=1;       //使能串口接收中断，
 //EA=1;       //打开所有中断
}

/**************************************************************************
 - 功能描述：51单片机的串口中断处理函数
 - 隶属模块：STC51串口操作
 - 函数属性：外部，使用户使用(在此中断函数中常用来处理从串口收到的数据)
 - 参数说明：无
 - 返回说明：无
 **************************************************************************/

void sio_int() interrupt 4  //串口中断函数
{
 ES=0;
  //串口中断处理

 ES=1;
}

/**************************************************************************
 - 功能描述：51单片机的串口发送字节的函数
 - 隶属模块：STC51串口操作
 - 函数属性：外部，使用户使用
 - 参数说明：mydata:要发送的一个字节
 - 返回说明：无
 - 注：发送一个字节，是串口发送的基础操作
 **************************************************************************/

void UART_Send_Byte(unsigned char mydata)	
{
 TI=0;
 SBUF=mydata;
 while(!TI);
 TI=0;
}

/**************************************************************************
 - 功能描述：51单片机的串口发送0d 0a ，即回车换行
 - 隶属模块：STC51串口操作
 - 函数属性：外部，使用户使用
 - 参数说明：无
 - 返回说明：无
 - 注：此函数就是发送0d 0a这两个字节，在“超级终端”上会有回车换行的效果
 **************************************************************************/

void UART_Send_Enter()
{
 UART_Send_Byte(0x0d);
 UART_Send_Byte(0x0a);
}

/**************************************************************************
 - 功能描述：51单片机的串口发送字符串
 - 隶属模块：STC51串口操作
 - 函数属性：外部，使用户使用
 - 参数说明：s:指向字符串的指针
 - 返回说明：无
 - 注：如果在字符串中有'\n'，则会发送一个回车换行
 **************************************************************************/

void UART_Send_Str(char *s)
{
 int len=strlen(s)-1;
 int i;
 for(i=0;i<len;i++)
 UART_Send_Byte(s[i]);
 if(s[i]=='\n') 
 {
  UART_Send_Enter();
 }
 else
 {
  UART_Send_Byte(s[i]);
 }
}

/**************************************************************************
 - 功能描述：51单片机的串口发送数值
 - 隶属模块：STC51串口操作
 - 函数属性：外部，使用户使用
 - 参数说明：dat:要发送的数值
 - 返回说明：无
 - 注：函数中会将数值转为相应的字符串，发送出去。比如 4567 转为 "4567" 
 **************************************************************************/

void UART_Put_Num(unsigned long dat)
{
 char temp[20];
 u32tostr(dat,temp);
 UART_Send_Str(temp);
}

/**************************************************************************
 - 功能描述：51单片机的串口发送调试信息
 - 隶属模块：STC51串口操作
 - 函数属性：外部，使用户使用
 - 参数说明：inf:指向提示信息字符串的指针
             dat:一个数值，前面的提示信息就是在说明这个数值的意义
 - 返回说明：无
 **************************************************************************/

void UART_Put_Inf(char *inf,unsigned long dat)
{
 UART_Send_Str(inf);
 UART_Put_Num(dat);
 UART_Send_Str("\n");  
}